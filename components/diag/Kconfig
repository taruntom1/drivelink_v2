## components/time_sync/Kconfig
```kconfig
menu "Time Sync Configuration"

    config TIME_SYNC_REQUEST_MSG_TYPE
        hex "Time sync request message type"
        default 0x20
        range 0x01 0x3F
        help
            UART message type for time sync requests sent by the target
            (command class range 0x01..0x3F).

    config TIME_SYNC_RESPONSE_MSG_TYPE
        hex "Time sync response message type"
        default 0x60
        range 0x40 0x7F
        help
            UART message type for time sync responses sent by the host
            (response class range 0x40..0x7F).

endmenu
```

## firmware/components/core/Kconfig
```kconfig
menu "DriveLink core"

    config CORE_STATUS_CPU_LOAD
        bool "Measure per-core CPU utilization in status"
        default y
        select FREERTOS_GENERATE_RUN_TIME_STATS
        help
            Samples idle runtime counters with constant work per core.
            ESP timer must be the runtime stats clock. No stack scan is used.


    config CORE_COMMAND_QUEUE_DEPTH
        int "Core command queue depth"
        default 8
        range 1 32
    config CORE_COMMAND_TASK_STACK
        int "Core config task stack bytes"
        default 6144
        range 4096 16384
    config CORE_COMMAND_TASK_PRIO
        int "Core config task priority"
        default 5
        range 1 19
endmenu
```

## firmware/components/motor_controller/Kconfig
```kconfig
menu "Motor Controller Configuration"

    config MOTOR_CTRL_DEFAULT_COUNTS_PER_REV
        int "Default encoder counts per output revolution"
        default 1440
        range 1 1000000
        help
            Total encoder quadrature counts per one full revolution of the shaft
            being measured. For a 4x-decoded quadrature encoder with N pulses/rev,
            set this to N * 4. Example: a 360 CPR encoder gives 1440 counts/rev.
            Overridden per-instance via MotorControllerConfig::counts_per_rev.

    config MOTOR_CTRL_DEFAULT_VEL_FILTER_CUTOFF_HZ
        int "Default velocity estimate filter cutoff (Hz)"
        default 50
        range 0 10000
        help
            Cutoff frequency of the first-order low-pass filter applied to the
            velocity estimate. Velocity is computed every update() from the
            encoder count delta divided by dt, which is coarsely quantized at
            high loop rates (one count per period), so some filtering is
            usually needed. Lower cutoffs give smoother readings but add phase
            lag to the velocity loop. 0 disables the filter.
            Overridden per-instance via
            MotorControllerConfig::velocity_filter_cutoff_hz.

endmenu
```

## firmware/components/motor_hal/Kconfig
```kconfig
menu "Motor HAL Configuration"

    config MOTOR_HAL_TIMER_RESOLUTION_HZ
        int "MCPWM timer resolution in Hz"
        default 10000000
        range 1000000 80000000
        help
            The resolution of the MCPWM timer clocks in Hz. Every motor's timer
            uses it; the PWM frequency is a setting of each motor.
            Higher resolution gives finer duty cycle granularity.
            With 10 MHz and 25 kHz, period = 400 ticks (0.25% granularity),
            the default. With 1 MHz it is 40 ticks (2.5%), too coarse for
            the low duty caps of a first motor run.

endmenu
```

## firmware/components/motor_manager/Kconfig
```kconfig
menu "Motor Manager Configuration"

    config MOTOR_MANAGER_CONFIGURE_MSG_TYPE
        hex "Configure command message type"
        default 0x21
        range 0x01 0x3F
        help
            UART message type used for motor manager configure requests
            (command class range 0x01..0x3F).

    config MOTOR_MANAGER_CONFIGURE_RESPONSE_MSG_TYPE
        hex "Configure response message type"
        default 0x61
        range 0x40 0x7F
        help
            UART message type used for motor manager configure responses
            (response class range 0x40..0x7F).

    config MOTOR_MANAGER_SETPOINT_STREAM_CHANNEL
        hex "Setpoint stream channel"
        default 0x80
        range 0x80 0xBF
        help
            UART stream channel for setpoint data from host to target
            (stream class range 0x80..0xBF).

    config MOTOR_MANAGER_TELEMETRY_STREAM_CHANNEL
        hex "Telemetry stream channel"
        default 0x81
        range 0x80 0xBF
        help
            UART stream channel for telemetry data from target to host
            (stream class range 0x80..0xBF).

    config MOTOR_MANAGER_USE_MOCK_FEEDBACK
        bool "Use setpoint-backed mock telemetry"
        default n
        help
            Enables a hardware-free mock mode for motor_manager. In this mode,
            motor setpoints are echoed as telemetry feedback values without
            creating real motor_controller instances.

    config MOTOR_MANAGER_DEFAULT_UPDATE_TASK_STACK
        int "Default motor manager control task stack size"
        default 4096
        range 2048 16384
        help
            Stack size in bytes for the optional internal control (update)
            task that runs the motor control loop and publishes telemetry.

    config MOTOR_MANAGER_DEFAULT_UPDATE_TASK_PRIO
        int "Default motor manager control task priority"
        default 20
        range 1 24
        help
            FreeRTOS priority for the optional internal control task. It is
            woken by an esp_timer callback, so keep it high (but below the
            esp_timer task, priority 22) to keep wake-up jitter low.

    config MOTOR_MANAGER_DEFAULT_CONTROL_TASK_CORE
        int "Default motor manager control task core (-1 = no affinity)"
        default 1
        range -1 1
        help
            Core the control task is pinned to. Core 1 keeps it away from the
            UART RX and config work, which typically runs on core 0.

    config MOTOR_MANAGER_DEFAULT_CONTROL_PERIOD_US
        int "Default control loop period (us)"
        default 1000
        range 250 100000
        help
            Period of the esp_timer that drives the motor control loop. The
            host can change it at runtime with the SetTiming subcommand.
            The loop does not depend on CONFIG_FREERTOS_HZ.

    config MOTOR_MANAGER_DEFAULT_TELEMETRY_PERIOD_US
        int "Default telemetry period (us)"
        default 10000
        range 250 1000000
        help
            Telemetry is published every N control ticks, where N is this
            period divided by the control period, rounded up. The host can
            change it at runtime with the SetTiming subcommand.

    config MOTOR_MANAGER_LOG_LOOP_STATS
        bool "Log control loop timing statistics"
        default n
        help
            Every 5 s, log the min/mean/max interval between control loop
            runs and the min/mean/max time spent in one run. Useful for
            checking jitter on hardware.

    config MOTOR_MANAGER_DEFAULT_CONFIG_TASK_STACK
        int "Default motor manager config task stack size"
        default 4096
        range 2048 16384
        help
            Stack size in bytes for the internal configuration command task.
            This task parses and dispatches queued configure commands.

    config MOTOR_MANAGER_DEFAULT_CONFIG_TASK_PRIO
        int "Default motor manager config task priority"
        default 6
        range 1 24
        help
            FreeRTOS priority for the internal configuration command task.

    config MOTOR_MANAGER_CONFIG_QUEUE_DEPTH
        int "Configure command queue depth"
        default 8
        range 1 32
        help
            Number of configure frames the UART RX callback can queue for the
            config task. A full queue drops the command (logged).

    config MOTOR_MANAGER_MUTEX_TIMEOUT_MS
        int "Manager mutex timeout (ms)"
        default 50
        range 1 1000
        help
            How long configure commands and the manual update/telemetry API
            wait for the manager mutex before failing with INTERNAL_ERROR.
            The control tick never waits: it only try-locks.

endmenu
```

## firmware/components/pid/Kconfig
```kconfig
menu "PID Controller Configuration"

    config PID_DEFAULT_OUTPUT_MIN
        int "Default output minimum (x1000)"
        default -1000
        range -100000 0
        help
            Default lower output limit, scaled by 1000.
            -1000 represents -1.0 (full reverse).
            Can be overridden per-instance via PidConfig::output_min.

    config PID_DEFAULT_OUTPUT_MAX
        int "Default output maximum (x1000)"
        default 1000
        range 0 100000
        help
            Default upper output limit, scaled by 1000.
            1000 represents 1.0 (full forward).
            Can be overridden per-instance via PidConfig::output_max.

    config PID_DEFAULT_DERIVATIVE_CUTOFF_HZ
        int "Default derivative filter cutoff (Hz)"
        default 0
        range 0 10000
        help
            Cutoff frequency of the first-order low-pass filter on the
            derivative term. 0 disables the filter (raw derivative).
            Because it is a frequency rather than a per-sample coefficient,
            the filter behaves the same at any loop rate.
            Can be overridden per-instance via PidConfig::derivative_cutoff_hz.

endmenu
```

## firmware/components/rotary_encoder_hal/Kconfig
```kconfig
menu "Rotary Encoder HAL Configuration"

    config ENCODER_HAL_PCNT_HIGH_LIMIT
        int "PCNT counter high limit"
        default 32767
        range 100 32767
        help
            Upper limit for the 16-bit PCNT hardware counter.
            When reached, the counter wraps and the accumulator tracks the overflow.
            Use the maximum (32767) to minimize overflow interrupt frequency.

    config ENCODER_HAL_PCNT_LOW_LIMIT
        int "PCNT counter low limit"
        default -32768
        range -32768 -100
        help
            Lower limit for the 16-bit PCNT hardware counter.
            When reached, the counter wraps and the accumulator tracks the overflow.
            Use the minimum (-32768) to minimize overflow interrupt frequency.

endmenu
```

## firmware/components/time_sync/Kconfig
```kconfig
menu "Time Sync Configuration"

    config TIME_SYNC_TASK_STACK
        int "Periodic sync task stack size"
        default 4096
        range 2048 16384
        help
            Default stack size in bytes for the periodic sync task
            (TimeSyncConfig::task_stack_size).

    config TIME_SYNC_TASK_PRIO
        int "Periodic sync task priority"
        default 6
        range 1 24
        help
            Default FreeRTOS priority for the periodic sync task
            (TimeSyncConfig::task_priority).

endmenu
```

## firmware/components/uart_comm/Kconfig
```kconfig
menu "UART Comm Configuration"

    config UART_COMM_PORT_NUM
        int "UART port number"
        default 1
        range 0 2
        help
            Which UART peripheral to use (0, 1, or 2).
            UART 0 is typically used for console logging.

    config UART_COMM_MAX_PAYLOAD
        int "Maximum payload size in bytes"
        default 1024
        range 128 1024
        help
            Largest payload this firmware sends or accepts per frame. The
            protocol limit is 1024 (drivelink::protocol::kMaxPayload); a
            build may use a smaller receive limit, never a larger one.
            Sizes RxFrame (and every queue of RxFrames), the command buffer
            pool and the scanner window.

    config UART_COMM_RX_BUF_SIZE
        int "UART RX ring buffer size"
        default 4096
        range 256 8192
        help
            Size of the UART driver receive ring buffer in bytes.
            4096 bytes hold about 44 ms of traffic at 921600 baud.

    config UART_COMM_TX_BUF_SIZE
        int "UART TX ring buffer size"
        default 4096
        range 0 8192
        help
            Size of the UART driver transmit ring buffer in bytes.
            Set to 0 for blocking TX mode. Keep it above one full frame
            (MAX_PAYLOAD + 9 bytes), or uart_write_bytes() blocks the TX
            task part-way through each large frame.

    config UART_COMM_CMD_QUEUE_DEPTH
        int "TX command queue depth"
        default 8
        range 2 32
        help
            Number of command/response/event frames that can be
            queued for transmission before sendCommand returns an error.

    config UART_COMM_RX_QUEUE_DEPTH
        int "RX delivery queue depth"
        default 8
        range 2 32
        help
            Number of received frames buffered for the application
            to consume via receive().

    config UART_COMM_RX_TASK_STACK
        int "RX task stack size"
        default 4096
        range 2048 16384
        help
            Stack size in bytes for the internal receive task.

    config UART_COMM_RX_TASK_PRIO
        int "RX task priority"
        default 5
        range 1 24
        help
            FreeRTOS priority for the internal receive task.

    config UART_COMM_TX_TASK_STACK
        int "TX task stack size"
        default 4096
        range 2048 16384
        help
            Stack size in bytes for the internal transmit task.

    config UART_COMM_TX_TASK_PRIO
        int "TX task priority"
        default 5
        range 1 24
        help
            FreeRTOS priority for the internal transmit task.

    config UART_COMM_EVENT_QUEUE_SIZE
        int "UART driver event queue size"
        default 20
        range 5 100
        help
            Length of the UART driver's event queue. Events only wake the
            RX task and report errors; received bytes are read straight from
            the ring buffer, so a full event queue does not lose data.

    config UART_COMM_RX_TIMEOUT_SYMBOLS
        int "RX timeout in symbol periods"
        default 10
        range 1 126
        help
            Number of symbol periods of silence before the UART
            hardware triggers an RX timeout interrupt. One symbol
            is approximately one byte transmission time.

endmenu
```

## firmware/main/Kconfig.projbuild
```kconfig
menu "DriveLink main"

    config CORE_BENCH_CRASH
        bool "Enable wire crash/stall commands (bare-board tests only)"
        default n
        help
            Enables BenchCrash (abort after reply) and BenchStall (deliberate loop
            busy work for safety monitor and Task WDT tests).
            Never enable in a deployed build.
endmenu
```
