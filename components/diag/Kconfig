## components/diag/Kconfig
```kconfig
menu "Diagnostics (diag)"

    config DIAG_EVENT_MSG_TYPE
        hex "Diag event message type"
        default 0xC0
        range 0xC0 0xFE
        help
            UART message type for diag events sent by the target (Record,
            CounterDelta, Cleared, Boot). Event class range 0xC0..0xFE.

    config DIAG_QUERY_MSG_TYPE
        hex "Diag query message type"
        default 0x23
        range 0x01 0x3F
        help
            UART message type for diag queries sent by the host (GetInfo,
            GetEntries, Clear). Command class range 0x01..0x3F.

    config DIAG_QUERY_RESPONSE_MSG_TYPE
        hex "Diag query response message type"
        default 0x63
        range 0x40 0x7F
        help
            UART message type for diag query responses sent by the target.
            Response class range 0x40..0x7F.

    config DIAG_RECORD_QUEUE_DEPTH
        int "Record queue depth"
        default 16
        range 4 128
        help
            Records and Cleared events waiting to be sent. It also holds the
            records reported during startup, before the reporter runs. A
            full queue drops the new record and counts diag.RecordDropped.
            Static storage: about 32 bytes per entry.

    config DIAG_QUERY_QUEUE_DEPTH
        int "Query queue depth"
        default 2
        range 1 8
        help
            Host queries waiting for the reporter task. A full queue drops
            the query and counts diag.QueryDropped.

    config DIAG_COUNTER_PERIOD_MS
        int "Counter delta period (ms)"
        default 1000
        range 100 60000
        help
            How often changed counters are sent as CounterDelta events.
            A counter that did not change sends nothing.

    config DIAG_REPORTER_POLL_MS
        int "Reporter poll period (ms)"
        default 20
        range 10 1000
        help
            How often the reporter task checks the record queue. Queries
            wake it immediately; records wait at most this long.

    config DIAG_TASK_STACK
        int "Reporter task stack size"
        default 4096
        range 2048 16384
        help
            Stack size in bytes for the diag reporter task.

    config DIAG_TASK_PRIO
        int "Reporter task priority"
        default 4
        range 1 24
        help
            FreeRTOS priority of the diag reporter task. Keep it below the
            control and sampling tasks.

    config DIAG_CONSOLE_LOG
        bool "Also log diag reports as console text"
        default y
        help
            When enabled, DIAG_ERROR / DIAG_WARN also print a console line
            (ESP_LOGE / ESP_LOGW). When disabled, the text part compiles to
            nothing (no format strings in the binary, arguments not
            evaluated), and the first-party components (components/ and
            main/) are built with LOG_LOCAL_LEVEL=ESP_LOG_NONE, so their
            remaining ESP_LOGx calls are removed too. ESP-IDF's own logs
            follow CONFIG_LOG_DEFAULT_LEVEL as usual. Codes are still sent
            over the UART either way.

endmenu
```

## components/imu_bmo_055/Kconfig
```kconfig
menu "IMU BNO055 Configuration"

    config IMU_BMO_055_CONFIGURE_MSG_TYPE
        hex "Configure command message type"
        default 0x22
        range 0x01 0x3F
        help
            UART message type used for IMU configure requests.

    config IMU_BMO_055_CONFIGURE_RESPONSE_MSG_TYPE
        hex "Configure response message type"
        default 0x42
        range 0x40 0x7F
        help
            UART message type used for IMU configure responses.

    config IMU_BMO_055_EVENT_MSG_TYPE
        hex "Event message type"
        default 0xC2
        range 0xC0 0xFE
        help
            UART message type used for asynchronous IMU events.

    config IMU_BMO_055_STREAM_CHANNEL
        hex "Telemetry stream channel"
        default 0x82
        range 0x80 0xBF
        help
            UART stream channel for IMU telemetry output.

    config IMU_BMO_055_USE_MOCK_DATA
        bool "Use mock IMU data source"
        default n
        help
            Bypass BNO055 hardware reads and publish synthesized telemetry
            over the IMU stream channel. Useful for host integration when
            sensor hardware is unavailable.

    config IMU_BMO_055_FALLBACK_TO_MOCK_ON_INIT_FAIL
        bool "Fallback to mock data when BNO055 init fails"
        default y
        depends on !IMU_BMO_055_USE_MOCK_DATA
        help
            If enabled, the manager stays valid and streams synthesized IMU
            data when BNO055 initialization fails.

    config IMU_BMO_055_I2C_PORT_NUM
        int "I2C port number"
        default 0
        range 0 1
        help
            ESP-IDF I2C controller index used to access BNO055.

    config IMU_BMO_055_I2C_SDA_PIN
        int "I2C SDA pin"
        default 8
        range 0 48
        help
            GPIO number used for I2C SDA.

    config IMU_BMO_055_I2C_SCL_PIN
        int "I2C SCL pin"
        default 9
        range 0 48
        help
            GPIO number used for I2C SCL.

    config IMU_BMO_055_I2C_CLK_HZ
        int "I2C clock speed (Hz)"
        default 400000
        range 10000 1000000
        help
            BNO055 I2C bus speed.

    config IMU_BMO_055_I2C_TIMEOUT_MS
        int "I2C transaction timeout (ms)"
        default 50
        range 1 1000
        help
            Timeout for I2C read and write operations.

    config IMU_BMO_055_DEVICE_ADDRESS
        hex "BNO055 I2C address"
        default 0x28
        range 0x28 0x29
        help
            BNO055 address set by ADR pin.

    config IMU_BMO_055_DEFAULT_OPERATION_MODE
        hex "Default operation mode"
        default 0x0C
        range 0x00 0x0C
        help
            Default BNO055 mode at startup. 0x0C corresponds to NDOF.

    config IMU_BMO_055_DEFAULT_STREAM_FIELD_MASK
        hex "Default stream field mask"
        default 0x1FF
        range 0x0000 0x1FF
        help
            Bitmask selecting fields included in telemetry stream.

    config IMU_BMO_055_DEFAULT_SAMPLE_PERIOD_US
        int "Default sample period (us)"
        default 10000
        range 1000 5000000
        help
            Default period of the sampling timer: how often the BNO055 is
            read. Clamped to [MIN, MAX] below. In the fusion modes the
            BNO055 updates its outputs at 100 Hz, so periods below 10000 us
            only give fresh data in the raw (non-fusion) modes.

    config IMU_BMO_055_DEFAULT_TELEMETRY_PERIOD_US
        int "Default telemetry period (us)"
        default 0
        range 0 5000000
        help
            Default period of the IMU stream packets. 0 means "same as the
            sample period". Rounded up to a whole multiple of the sample
            period (a sample is published every N samples).

    config IMU_BMO_055_MIN_SAMPLE_PERIOD_US
        int "Minimum sample period (us)"
        default 5000
        range 1000 5000000
        help
            Lower clamp bound for the sample period (startup default and
            SetStreamTiming). Must not exceed the maximum.

    config IMU_BMO_055_MAX_SAMPLE_PERIOD_US
        int "Maximum sample / telemetry period (us)"
        default 1000000
        range 1000 5000000
        help
            Upper clamp bound for both the sample period and the telemetry
            period. Must not be below the minimum.

    config IMU_BMO_055_STREAM_TASK_STACK
        int "Stream task stack size"
        default 4096
        range 2048 16384
        help
            Stack size in bytes for the IMU stream task.

    config IMU_BMO_055_STREAM_TASK_PRIO
        int "Stream task priority"
        default 6
        range 1 24
        help
            FreeRTOS priority for the IMU stream task.

    config IMU_BMO_055_CONFIG_TASK_STACK
        int "Config task stack size"
        default 4096
        range 2048 16384
        help
            Stack size in bytes for the IMU configuration task.

    config IMU_BMO_055_CONFIG_TASK_PRIO
        int "Config task priority"
        default 6
        range 1 24
        help
            FreeRTOS priority for the IMU configuration task.

    config IMU_BMO_055_CONFIG_QUEUE_DEPTH
        int "Configure command queue depth"
        default 8
        range 1 32
        help
            Queue depth for incoming runtime configure commands.

    config IMU_BMO_055_MUTEX_TIMEOUT_MS
        int "Manager mutex timeout (ms)"
        default 50
        range 1 1000
        help
            How long configure commands wait for the manager mutex before
            failing with BUSY.

    config IMU_BMO_055_DEVICE_LOCK_TIMEOUT_MS
        int "Device lock timeout for config operations (ms)"
        default 100
        range 1 1000
        help
            How long config operations (operation-mode switch, calibration
            read/write) wait for the BNO055 device lock. The stream tick
            never waits for it: it only try-locks.

endmenu
```

## components/motor_controller/Kconfig
```kconfig
menu "Motor Controller Configuration"

    config MOTOR_CTRL_DEFAULT_COUNTS_PER_REV
        int "Default encoder counts per output revolution"
        default 1440
        range 1 1000000
        help
            Total encoder quadrature counts per one full revolution of the shaft
            being measured. For a 4x-decoded quadrature encoder with N pulses/rev,
            set this to N * 4. Example: a 360 CPR encoder gives 1440 counts/rev.
            Overridden per-instance via MotorControllerConfig::counts_per_rev.

    config MOTOR_CTRL_DEFAULT_SAMPLE_TIME_MS
        int "Default PID sample time in milliseconds"
        default 10
        range 1 1000
        help
            Default control loop sample time for both velocity and position PID
            controllers. 10 ms (100 Hz) is typical for DC motor speed control.
            Overridden per-instance via the esp_pid::PidConfig fields inside
            MotorControllerConfig.

endmenu
```

## components/motor_manager/Kconfig
```kconfig
menu "Motor Manager Configuration"

    config MOTOR_MANAGER_CONFIGURE_MSG_TYPE
        hex "Configure command message type"
        default 0x21
        range 0x01 0x3F
        help
            UART message type used for motor manager configure requests
            (command class range 0x01..0x3F).

    config MOTOR_MANAGER_CONFIGURE_RESPONSE_MSG_TYPE
        hex "Configure response message type"
        default 0x61
        range 0x40 0x7F
        help
            UART message type used for motor manager configure responses
            (response class range 0x40..0x7F).

    config MOTOR_MANAGER_SETPOINT_STREAM_CHANNEL
        hex "Setpoint stream channel"
        default 0x80
        range 0x80 0xBF
        help
            UART stream channel for setpoint data from host to target
            (stream class range 0x80..0xBF).

    config MOTOR_MANAGER_TELEMETRY_STREAM_CHANNEL
        hex "Telemetry stream channel"
        default 0x81
        range 0x80 0xBF
        help
            UART stream channel for telemetry data from target to host
            (stream class range 0x80..0xBF).

    config MOTOR_MANAGER_USE_MOCK_FEEDBACK
        bool "Use setpoint-backed mock telemetry"
        default n
        help
            Enables a hardware-free mock mode for motor_manager. In this mode,
            motor setpoints are echoed as telemetry feedback values without
            creating real motor_controller instances.

    config MOTOR_MANAGER_DEFAULT_UPDATE_TASK_STACK
        int "Default motor manager update task stack size"
        default 4096
        range 2048 16384
        help
            Stack size in bytes for the optional internal update task that
            periodically calls MotorManager::updateAll().

    config MOTOR_MANAGER_DEFAULT_UPDATE_TASK_PRIO
        int "Default motor manager update task priority"
        default 6
        range 1 24
        help
            FreeRTOS priority for the optional internal update task.

    config MOTOR_MANAGER_DEFAULT_CONFIG_TASK_STACK
        int "Default motor manager config task stack size"
        default 4096
        range 2048 16384
        help
            Stack size in bytes for the internal configuration command task.
            This task parses and dispatches queued configure commands.

    config MOTOR_MANAGER_DEFAULT_CONFIG_TASK_PRIO
        int "Default motor manager config task priority"
        default 6
        range 1 24
        help
            FreeRTOS priority for the internal configuration command task.

endmenu
```

## components/pid/Kconfig
```kconfig
menu "PID Controller Configuration"

    config PID_DEFAULT_SAMPLE_TIME_MS
        int "Default sample time in milliseconds"
        default 10
        range 1 1000
        help
            Default PID computation interval. 10 ms (100 Hz) is typical
            for motor speed control. Can be overridden per-instance via
            PidConfig::sample_time_ms.

    config PID_DEFAULT_OUTPUT_MIN
        int "Default output minimum (x1000)"
        default -1000
        range -100000 0
        help
            Default lower output limit, scaled by 1000.
            -1000 represents -1.0 (full reverse).
            Can be overridden per-instance via PidConfig::output_min.

    config PID_DEFAULT_OUTPUT_MAX
        int "Default output maximum (x1000)"
        default 1000
        range 0 100000
        help
            Default upper output limit, scaled by 1000.
            1000 represents 1.0 (full forward).
            Can be overridden per-instance via PidConfig::output_max.

    config PID_DEFAULT_DERIVATIVE_FILTER_ALPHA
        int "Default derivative filter coefficient (x1000)"
        default 1000
        range 1 1000
        help
            Low-pass filter coefficient for the derivative term, scaled by 1000.
            1000 (=1.0) means no filtering (raw derivative).
            Lower values provide more smoothing.
            200 (=0.2) is a reasonable starting point for noisy measurements.

endmenu
```

## components/rotary_encoder_hal/Kconfig
```kconfig
menu "Rotary Encoder HAL Configuration"

    config ENCODER_HAL_GLITCH_FILTER_NS
        int "Glitch filter width in nanoseconds"
        default 1000
        range 0 10000
        help
            Hardware glitch filter duration for PCNT input signals.
            Pulses shorter than this value are rejected by the hardware.
            Set to 0 to disable the glitch filter entirely.
            1000 ns (1 us) is a good default for mechanical rotary encoders.

    config ENCODER_HAL_RATE_SAMPLE_PERIOD_MS
        int "Rate sampling period in milliseconds"
        default 50
        range 10 1000
        help
            Minimum time between on-demand rate samples.
            Rate/direction are recalculated when getRate()/getDirection()
            are called and at least this much time has elapsed.
            Shorter periods give faster response but noisier rate readings.
            Longer periods give smoother readings but slower response.
            50 ms (20 Hz) provides a good balance for motor control.

    config ENCODER_HAL_PCNT_HIGH_LIMIT
        int "PCNT counter high limit"
        default 32767
        range 100 32767
        help
            Upper limit for the 16-bit PCNT hardware counter.
            When reached, the counter wraps and the accumulator tracks the overflow.
            Use the maximum (32767) to minimize overflow interrupt frequency.

    config ENCODER_HAL_PCNT_LOW_LIMIT
        int "PCNT counter low limit"
        default -32768
        range -32768 -100
        help
            Lower limit for the 16-bit PCNT hardware counter.
            When reached, the counter wraps and the accumulator tracks the overflow.
            Use the minimum (-32768) to minimize overflow interrupt frequency.

endmenu
```
